## main/Kconfig.projbuild
```kconfig
menu "Hourglass hardware"

    config HOURGLASS_LCD_PIN_CS
        int "LCD CS GPIO"
        range 0 48
        default 10

    config HOURGLASS_LCD_PIN_MOSI
        int "LCD MOSI (SDA) GPIO"
        range 0 48
        default 11

    config HOURGLASS_LCD_PIN_SCK
        int "LCD SCK (SCL) GPIO"
        range 0 48
        default 12

    config HOURGLASS_LCD_PIN_DC
        int "LCD D/C GPIO"
        range 0 48
        default 13

    config HOURGLASS_LCD_PIN_RST
        int "LCD RESET GPIO"
        range 0 48
        default 14

    config HOURGLASS_LCD_PIXEL_CLOCK_MHZ
        int "LCD SPI clock (MHz)"
        range 1 40
        default 20

    config HOURGLASS_LCD_ROTATE_180
        bool "Rotate display 180 degrees"
        default n
        help
            Turn the picture upside down if the hourglass is mounted the other way round.

    config HOURGLASS_LCD_HIGH_POWER
        bool "Use high power mode (32 Hz refresh)"
        default y
        help
            High power mode refreshes the panel at 32 Hz, which smooth sand animation needs.
            Low power mode refreshes at 1 Hz.

endmenu
```
